## firmware/sdkconfig.defaults
```kconfig
# Target
CONFIG_IDF_TARGET="esp32c3"

# Flash
CONFIG_ESPTOOLPY_FLASHSIZE_4MB=y
CONFIG_ESPTOOLPY_FLASHMODE_DIO=y
CONFIG_ESPTOOLPY_FLASHFREQ_80M=y

# Partition table
CONFIG_PARTITION_TABLE_CUSTOM=y
CONFIG_PARTITION_TABLE_CUSTOM_FILENAME="partitions.csv"

# WiFi - required for ESP-NOW
CONFIG_ESP_WIFI_ENABLED=y
CONFIG_ESP_WIFI_SOFTAP_SUPPORT=y

# Disable Bluetooth completely
CONFIG_BT_ENABLED=n

# Performance
CONFIG_ESP_DEFAULT_CPU_FREQ_MHZ_160=y
CONFIG_FREERTOS_HZ=1000

# Power management off for low latency
CONFIG_PM_ENABLE=n

# Log level
CONFIG_LOG_DEFAULT_LEVEL_INFO=y

# Brownout
CONFIG_BROWNOUT_DET_LVL_SEL_7=y

# Compiler optimization
CONFIG_COMPILER_OPTIMIZATION_DEBUG=y
```
